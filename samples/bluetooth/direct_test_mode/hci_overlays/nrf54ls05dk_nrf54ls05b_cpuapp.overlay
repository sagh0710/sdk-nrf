/* SPDX-License-Identifier: Apache-2.0 */
/* nRF54LS05 (Ultralight) EBQ overlay - UART for HCI */

/ {
	chosen {
		zephyr,bt-c2h-uart = &uart20;
	};
};

&uart20 {
	current-speed = <1000000>;
	status = "okay";
	hw-flow-control;
};
